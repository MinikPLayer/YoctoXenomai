## poky/meta-zynq-defconfig/conf/layer.conf
```bitbake
# We have a conf and classes directory, add to BBPATH
BBPATH .= ":${LAYERDIR}"

# We have recipes-* directories, add to BBFILES
BBFILES += "${LAYERDIR}/recipes-*/*/*.bb \
            ${LAYERDIR}/recipes-*/*/*.bbappend"

BBFILE_COLLECTIONS += "meta-zynq-defconfig"
BBFILE_PATTERN_meta-zynq-defconfig = "^${LAYERDIR}/"
BBFILE_PRIORITY_meta-zynq-defconfig = "6"

LAYERDEPENDS_meta-zynq-defconfig = "core"
LAYERSERIES_COMPAT_meta-zynq-defconfig = "warrior"
```
